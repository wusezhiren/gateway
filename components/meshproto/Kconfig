## components/meshproto/Kconfig
```kconfig
menu "Mesh protocol (ESP-NOW)"

    config MP_ENCRYPT
        bool "Encrypt unicast ESP-NOW frames"
        default y
        help
            Gateway and nodes add each other as encrypted peers after pairing.
            Broadcast JOIN frames are always unencrypted.
            ESP-NOW supports at most 17 encrypted peers.

    config MP_PMK
        string "Primary master key (exactly 16 chars)"
        default "esp-s3-mesh-pmk!"
        depends on MP_ENCRYPT

    config MP_LMK
        string "Local master key (exactly 16 chars)"
        default "esp-s3-mesh-lmk!"
        depends on MP_ENCRYPT

endmenu
```

## gateway/main/Kconfig.projbuild
```kconfig
menu "Gateway"

    config GW_DEFAULT_CHANNEL
        int "ESP-NOW channel when no router is configured"
        range 1 13
        default 1
        help
            Once connected to a router, the gateway follows the router's channel
            and nodes find it by scanning.

    config GW_PROV_AP_PASSWORD
        string "Provisioning SoftAP password (8-63 chars, empty = random each time)"
        default "a12345678"

    config GW_LCD_BL_EXP_PIN
        int "TCA9554 pin controlling LCD backlight (-1 = unknown, only panel sleep)"
        range -1 7
        default -1
        help
            Screen-off turns this expander pin low. Use the console 'exp <pin> <0|1>'
            command to find which pin is the backlight on your board.

    config GW_SCREEN_OFF_S
        int "Default screen-off timeout in seconds (0 = always on)"
        default 60

    config GW_MAX_NODES
        int "Maximum number of paired nodes"
        range 1 14
        default 14
        help
            Limited by ESP_WIFI_ESPNOW_MAX_ENCRYPT_NUM; encrypted ESP-NOW peers and
            SoftAP clients share 17 hardware keys (3 are kept for provisioning).

    menu "Debug"
        config GW_TEST_ABORT_BEFORE_VALIDATE
            bool "Abort before marking OTA image valid (rollback test only)"
            default n
            help
                Builds a deliberately broken firmware: after an OTA it aborts before
                confirming itself, so the bootloader must roll back. Never ship this.
    endmenu

endmenu
```

## gateway_s31/main/Kconfig.projbuild
```kconfig
menu "S31 Gateway"

    menu "Message bus"
        config GW_S31_MSGBUS_QUEUE_LENGTH
            int "Message queue length"
            range 4 128
            default 16
        config GW_S31_MSGBUS_MAX_SUBSCRIBERS
            int "Maximum subscribers per message"
            range 1 16
            default 4
        config GW_S31_MSGBUS_PAYLOAD_SIZE
            int "Inline message payload size"
            range 16 512
            default 128
        config GW_S31_MSGBUS_TASK_STACK
            int "Message bus task stack size"
            range 2048 16384
            default 4096
        config GW_S31_MSGBUS_TASK_PRIORITY
            int "Message bus task priority"
            range 1 24
            default 8
        config GW_S31_MSGBUS_TASK_CORE
            int "Message bus task CPU core"
            range 0 1
            default 0
    endmenu

    menu "Board peripherals"
        config GW_S31_ENABLE_DISPLAY
            bool "RGB LCD and GT911 touch"
            default y
            help
                Enable the 800x480 RGB display and GT911 touch controller.

        config GW_S31_LVGL_DRAW_LINES
            int "LVGL partial draw buffer height (lines)"
            depends on GW_S31_ENABLE_DISPLAY
            range 8 80
            default 20

        config GW_S31_LVGL_TICK_MS
            int "LVGL tick interval (ms)"
            depends on GW_S31_ENABLE_DISPLAY
            range 5 100
            default 20

        config GW_S31_LVGL_MAX_SLEEP_MS
            int "LVGL maximum sleep (ms)"
            depends on GW_S31_ENABLE_DISPLAY
            range 20 1000
            default 100

        config GW_S31_LVGL_PRIORITY
            int "LVGL task priority (below wake and gateway tasks)"
            depends on GW_S31_ENABLE_DISPLAY
            range 1 10
            default 3

        config GW_S31_SCREEN_OFF_S
            int "Screen off after no touch (seconds)"
            depends on GW_S31_ENABLE_DISPLAY
            range 1 3600
            default 15

        config GW_S31_ENABLE_AUDIO
            bool "ES8389 audio codec"
            default y
            help
                Enable the ES8389 speaker and dual microphone interfaces.

        config GW_S31_ENABLE_SD
            bool "MicroSD card"
            default y

        config GW_S31_ENABLE_KEYS
            bool "ADC keys"
            default y

        config GW_S31_ENABLE_WS2812
            bool "WS2812 status LED"
            default y

        config GW_S31_ENABLE_BUZZER
            bool "Buzzer"
            default n

        config GW_S31_ENABLE_UART1
            bool "UART1 header"
            default n

        config GW_S31_ENABLE_RS485
            bool "RS485 interface"
            default n

        config GW_S31_ENABLE_CAN
            bool "CAN interface"
            default n
    endmenu

    menu "Board diagnostics"
        config GW_S31_DIAGNOSTIC_LOG
            bool "Log enabled peripheral initialization"
            default y
    endmenu
endmenu
```

## gateway_s31/sdkconfig.defaults.display
```kconfig
CONFIG_GW_S31_ENABLE_DISPLAY=y
CONFIG_GW_S31_ENABLE_AUDIO=n
CONFIG_GW_S31_ENABLE_SD=n
CONFIG_GW_S31_ENABLE_KEYS=n
CONFIG_GW_S31_ENABLE_WS2812=n
CONFIG_GW_S31_ENABLE_BUZZER=n
```

## gateway_s31/sdkconfig.defaults.min
```kconfig
CONFIG_GW_S31_ENABLE_DISPLAY=n
CONFIG_GW_S31_ENABLE_AUDIO=n
CONFIG_GW_S31_ENABLE_SD=n
CONFIG_GW_S31_ENABLE_KEYS=n
CONFIG_GW_S31_ENABLE_WS2812=n
CONFIG_GW_S31_ENABLE_BUZZER=n
CONFIG_GW_S31_ENABLE_UART1=n
CONFIG_GW_S31_ENABLE_RS485=n
CONFIG_GW_S31_ENABLE_CAN=n
```

## node/main/Kconfig.projbuild
```kconfig
menu "Node"

    config NODE_NAME
        string "Node name prefix (last 2 MAC bytes appended)"
        default "node"

    config NODE_RELAY_GPIOS
        string "Relay GPIOs, comma separated (empty = none)"
        default "4,5"

    config NODE_RELAY_ACTIVE_LOW
        bool "Relays are active low"
        default n

    config NODE_EXP_RELAY_PINS
        string "Relay channels on a TCA9554 I2C IO expander, pins 0..7 comma separated (empty = none)"
        default ""
        help
            For boards whose outputs sit behind an IO expander, e.g. the Korvo
            user LED GP_LED_2 on TCA9554 P7. Added after the GPIO relays.

    config NODE_EXP_ACTIVE_LOW
        bool "Expander outputs are active low"
        depends on NODE_EXP_RELAY_PINS != ""
        default n

    config NODE_EXP_I2C_SDA
        int "IO expander I2C SDA GPIO"
        depends on NODE_EXP_RELAY_PINS != ""
        default 17

    config NODE_EXP_I2C_SCL
        int "IO expander I2C SCL GPIO"
        depends on NODE_EXP_RELAY_PINS != ""
        default 18

    config NODE_PWM_GPIOS
        string "PWM GPIOs, comma separated (empty = none)"
        default "6"
        help
            PWM channels take values 0..1000 (per mille duty).

    config NODE_PWM_ACTIVE_LOW
        bool "PWM output inverted (e.g. LED to VCC)"
        default n

    config NODE_BREATH_GPIOS
        string "Breathing LED GPIOs, comma separated (empty = none)"
        default ""
        help
            Switch channels: while on, the LED fades in and out (3 s period).
            Driven by LEDC, polarity follows NODE_PWM_ACTIVE_LOW. Added after the PWM channels.

    config NODE_BLINK_GPIOS
        string "Slow blink LED GPIOs, comma separated (empty = none)"
        default ""
        help
            Switch channels: while on, the LED blinks 1 s on / 1 s off.
            Driven by LEDC, polarity follows NODE_PWM_ACTIVE_LOW. Added after the breathing LEDs.

    config NODE_RGB_GPIO
        int "WS2812 RGB LED GPIO, -1 for none"
        range -1 48
        default 48 if IDF_TARGET_ESP32S3
        default -1
        help
            One addressable RGB LED as a colour light channel, added after the PWM
            channels. Most ESP32-S3 core boards (DevKitC-1 v1.1, N16R8 core board)
            have it on GPIO48.

    config NODE_RESET_GPIO
        int "Button to forget gateway (hold 3 s), -1 to disable"
        range -1 48
        default 9 if IDF_TARGET_ESP32C3
        default 0

    config NODE_SLEEP_INTERVAL_S
        int "Deep sleep while all channels are off, wake every N seconds (0 = never sleep)"
        range 0 3600
        default 10
        help
            When every channel is off the node deep sleeps and wakes every N seconds to
            rejoin the gateway, which then delivers commands queued in the meantime, so
            commands take up to N seconds. Any channel on keeps the node awake. Not within
            30 s of power-on (time to flash over USB or hold the reset button), while unbound,
            during an OTA, or while the gateway asks it to stay awake.

    config NODE_TEST_NO_JOIN_AFTER_OTA
        bool "After an OTA, never contact the gateway (rollback test only)"
        default n
        help
            Builds a deliberately broken firmware: after an OTA it stays silent, so the
            validate timer must roll it back. Never ship this.

endmenu
```

## node/sdkconfig.defaults
```kconfig
# 目标芯片用 idf.py set-target esp32s3 / esp32c3 选择
CONFIG_ESPTOOLPY_FLASHSIZE_4MB=y
CONFIG_PARTITION_TABLE_CUSTOM=y
CONFIG_PARTITION_TABLE_CUSTOM_FILENAME="partitions.csv"
CONFIG_BOOTLOADER_APP_ROLLBACK_ENABLE=y
# 签名镜像：不烧 eFuse，仅在 OTA 时校验签名
CONFIG_SECURE_SIGNED_APPS_NO_SECURE_BOOT=y
CONFIG_SECURE_SIGNED_APPS_RSA_SCHEME=y
CONFIG_SECURE_SIGNED_ON_UPDATE_NO_SECURE_BOOT=y
CONFIG_SECURE_BOOT_BUILD_SIGNED_BINARIES=y
CONFIG_SECURE_BOOT_SIGNING_KEY="../keys/signing_key.pem"
# ESP-NOW 加密 peer 上限（硬件最多 17）
CONFIG_ESP_WIFI_ESPNOW_MAX_ENCRYPT_NUM=17
```
